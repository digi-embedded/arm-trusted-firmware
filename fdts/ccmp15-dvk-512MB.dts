// SPDX-License-Identifier: (GPL-2.0+ OR BSD-3-Clause)
/*
 * Copyright (C) 2023, Digi International Inc - All Rights Reserved
 */
/dts-v1/;

/* Digi ConnectCore CCMP15 DVK */
#include "ccmp15-dvk.dtsi"
/* DDR Configuration */
#include "ccmp1-ddr3l-1x4Gb-1066-binG.dtsi"
#include "stm32mp15-ddr.dtsi"		/* DDR */

/ {
	memory@c0000000 {
		device_type = "memory";
		reg = <0xC0000000 0x20000000>;
	};
};

