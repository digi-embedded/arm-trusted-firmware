// SPDX-License-Identifier: (GPL-2.0+ OR BSD-3-Clause)
/*
 * Copyright (c) 2022, STMicroelectronics - All Rights Reserved
 * Copyright (C) 2022, Digi International Inc - All Rights Reserved
 */

#define DDR_SIZE	0x10000000 /* 256MB */
#include "stm32mp13-fw-config.dtsi"
#include "stm32mp13-fw-config-mem-encrypt.dtsi"
