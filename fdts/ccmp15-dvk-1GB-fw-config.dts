// SPDX-License-Identifier: (GPL-2.0+ OR BSD-3-Clause)
/*
 * Copyright (c) 2020, STMicroelectronics - All Rights Reserved
 * Copyright (C) 2023, Digi International Inc - All Rights Reserved
*/

#define DDR_SIZE	0x40000000 /* 1GiB */
#include "stm32mp15-fw-config.dtsi"
