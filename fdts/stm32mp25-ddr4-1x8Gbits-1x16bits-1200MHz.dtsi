// SPDX-License-Identifier: GPL-2.0+ OR BSD-3-Clause
/*
 * Copyright (C) 2022-2023, STMicroelectronics - All Rights Reserved
 * Copyright (C) 2024,2025 Digi International Inc - All Rights Reserved
 */

/*
 * ConnectCore MP25 DVK board configuration
 * DDR4 1x8Gbits 1x16bits 1200MHz
 *
 * File generated by STM32CubeMX DDR Tool for MPUs v6.15.0
 * DDR type: DDR4
 * DDR width: 16bits
 * DDR density: 8Gb
 * System frequency: 1200000kHz
 * Address mapping type: RBC
 *
 * Save Date: 2025.09.10, save Time: 10:53:19
 */

#define DDR_MEM_NAME	"DDR4 1x8Gbits 1x16bits 1200MHz"
#define DDR_MEM_SPEED	1200000
#define DDR_MEM_SIZE	0x40000000

#define DDR_MSTR 0x01041010
#define DDR_MRCTRL0 0x00000030
#define DDR_MRCTRL1 0x00000000
#define DDR_MRCTRL2 0x00000000
#define DDR_DERATEEN 0x00000000
#define DDR_DERATEINT 0x00000000
#define DDR_DERATECTL 0x00000000
#define DDR_PWRCTL 0x00000000
#define DDR_PWRTMG 0x00130001
#define DDR_HWLPCTL 0x00000002
#define DDR_RFSHCTL0 0x00210010
#define DDR_RFSHCTL1 0x00000000
#define DDR_RFSHCTL3 0x00000000
#define DDR_RFSHTMG 0x009200d2
#define DDR_RFSHTMG1 0x008c0000
#define DDR_CRCPARCTL0 0x00000000
#define DDR_CRCPARCTL1 0x00001000
#define DDR_INIT0 0xc0020002
#define DDR_INIT1 0x00010002
#define DDR_INIT2 0x00000d00
#define DDR_INIT3 0x09400103
#define DDR_INIT4 0x00180000
#define DDR_INIT5 0x00100004
#define DDR_INIT6 0x00080460
#define DDR_INIT7 0x00000c16
#define DDR_DIMMCTL 0x00000000
#define DDR_RANKCTL 0x0000066f
#define DDR_RANKCTL1 0x0000000d
#define DDR_DRAMTMG0 0x11152815
#define DDR_DRAMTMG1 0x0004051e
#define DDR_DRAMTMG2 0x0609060d
#define DDR_DRAMTMG3 0x0050400c
#define DDR_DRAMTMG4 0x0904050a
#define DDR_DRAMTMG5 0x06060403
#define DDR_DRAMTMG6 0x02020005
#define DDR_DRAMTMG7 0x00000202
#define DDR_DRAMTMG8 0x04041007
#define DDR_DRAMTMG9 0x0002040a
#define DDR_DRAMTMG10 0x001c180a
#define DDR_DRAMTMG11 0x4408021c
#define DDR_DRAMTMG12 0x0c020010
#define DDR_DRAMTMG13 0x1c200004
#define DDR_DRAMTMG14 0x000000a0
#define DDR_DRAMTMG15 0x00000000
#define DDR_ZQCTL0 0x01000040
#define DDR_ZQCTL1 0x2000493e
#define DDR_ZQCTL2 0x00000000
#define DDR_DFITMG0 0x038f8209
#define DDR_DFITMG1 0x00080303
#define DDR_DFILPCFG0 0x07004111
#define DDR_DFILPCFG1 0x00000000
#define DDR_DFIUPD0 0xc0300018
#define DDR_DFIUPD1 0x005700b4
#define DDR_DFIUPD2 0x80000000
#define DDR_DFIMISC 0x00000041
#define DDR_DFITMG2 0x00000f09
#define DDR_DFITMG3 0x00000000
#define DDR_DBICTL 0x00000001
#define DDR_DFIPHYMSTR 0x80000000
#define DDR_ADDRMAP0 0x0000001f
#define DDR_ADDRMAP1 0x003f0808
#define DDR_ADDRMAP2 0x00000600
#define DDR_ADDRMAP3 0x1f000000
#define DDR_ADDRMAP4 0x00001f1f
#define DDR_ADDRMAP5 0x060f0606
#define DDR_ADDRMAP6 0x06060606
#define DDR_ADDRMAP7 0x00000f0f
#define DDR_ADDRMAP8 0x00003f01
#define DDR_ADDRMAP9 0x06060606
#define DDR_ADDRMAP10 0x06060606
#define DDR_ADDRMAP11 0x00000006
#define DDR_ODTCFG 0x06000618
#define DDR_ODTMAP 0x00000001
#define DDR_SCHED 0x80001b00
#define DDR_SCHED1 0x00000000
#define DDR_PERFHPR1 0x04000200
#define DDR_PERFLPR1 0x08000080
#define DDR_PERFWR1 0x08000400
#define DDR_SCHED3 0x04040208
#define DDR_SCHED4 0x08400810
#define DDR_DBG0 0x00000000
#define DDR_DBG1 0x00000000
#define DDR_DBGCMD 0x00000000
#define DDR_SWCTL 0x00000000
#define DDR_SWCTLSTATIC 0x00000000
#define DDR_POISONCFG 0x00000000
#define DDR_PCCFG 0x00000000
#define DDR_PCFGR_0 0x00704100
#define DDR_PCFGW_0 0x00004100
#define DDR_PCTRL_0 0x00000000
#define DDR_PCFGQOS0_0 0x0021000c
#define DDR_PCFGQOS1_0 0x01000080
#define DDR_PCFGWQOS0_0 0x01100c07
#define DDR_PCFGWQOS1_0 0x04000200
#define DDR_PCFGR_1 0x00704100
#define DDR_PCFGW_1 0x00004100
#define DDR_PCTRL_1 0x00000000
#define DDR_PCFGQOS0_1 0x00100007
#define DDR_PCFGQOS1_1 0x01000080
#define DDR_PCFGWQOS0_1 0x01100c07
#define DDR_PCFGWQOS1_1 0x04000200
#define DDR_UIB_DRAMTYPE 0x00000000
#define DDR_UIB_DIMMTYPE 0x00000004
#define DDR_UIB_LP4XMODE 0x00000000
#define DDR_UIB_NUMDBYTE 0x00000004
#define DDR_UIB_NUMACTIVEDBYTEDFI0 0x00000002
#define DDR_UIB_NUMACTIVEDBYTEDFI1 0x00000000
#define DDR_UIB_NUMANIB 0x00000008
#define DDR_UIB_NUMRANK_DFI0 0x00000001
#define DDR_UIB_NUMRANK_DFI1 0x00000001
#define DDR_UIB_DRAMDATAWIDTH 0x00000010
#define DDR_UIB_NUMPSTATES 0x00000001
#define DDR_UIB_FREQUENCY_0 0x000004b0
#define DDR_UIB_PLLBYPASS_0 0x00000000
#define DDR_UIB_DFIFREQRATIO_0 0x00000001
#define DDR_UIB_DFI1EXISTS 0x00000001
#define DDR_UIB_TRAIN2D 0x00000000
#define DDR_UIB_HARDMACROVER 0x00000003
#define DDR_UIB_READDBIENABLE_0 0x00000000
#define DDR_UIB_DFIMODE 0x00000000
#define DDR_UIA_LP4RXPREAMBLEMODE_0 0x00000000
#define DDR_UIA_LP4POSTAMBLEEXT_0 0x00000000
#define DDR_UIA_D4RXPREAMBLELENGTH_0 0x00000000
#define DDR_UIA_D4TXPREAMBLELENGTH_0 0x00000000
#define DDR_UIA_EXTCALRESVAL 0x00000000
#define DDR_UIA_IS2TTIMING_0 0x00000000
#define DDR_UIA_ODTIMPEDANCE_0 0x00000035
#define DDR_UIA_TXIMPEDANCE_0 0x00000028
#define DDR_UIA_ATXIMPEDANCE 0x00000028
#define DDR_UIA_MEMALERTEN 0x00000000
#define DDR_UIA_MEMALERTPUIMP 0x00000000
#define DDR_UIA_MEMALERTVREFLEVEL 0x00000000
#define DDR_UIA_MEMALERTSYNCBYPASS 0x00000000
#define DDR_UIA_DISDYNADRTRI_0 0x00000001
#define DDR_UIA_PHYMSTRTRAININTERVAL_0 0x00000000
#define DDR_UIA_PHYMSTRMAXREQTOACK_0 0x00000000
#define DDR_UIA_WDQSEXT 0x00000000
#define DDR_UIA_CALINTERVAL 0x00000009
#define DDR_UIA_CALONCE 0x00000000
#define DDR_UIA_LP4RL_0 0x00000000
#define DDR_UIA_LP4WL_0 0x00000000
#define DDR_UIA_LP4WLS_0 0x00000000
#define DDR_UIA_LP4DBIRD_0 0x00000000
#define DDR_UIA_LP4DBIWR_0 0x00000000
#define DDR_UIA_LP4NWR_0 0x00000000
#define DDR_UIA_LP4LOWPOWERDRV 0x00000000
#define DDR_UIA_DRAMBYTESWAP 0x00000000
#define DDR_UIA_RXENBACKOFF 0x00000000
#define DDR_UIA_TRAINSEQUENCECTRL 0x00000000
#define DDR_UIA_SNPSUMCTLOPT 0x00000000
#define DDR_UIA_SNPSUMCTLF0RC5X_0 0x00000000
#define DDR_UIA_TXSLEWRISEDQ_0 0x0000000f
#define DDR_UIA_TXSLEWFALLDQ_0 0x0000000f
#define DDR_UIA_TXSLEWRISEAC 0x0000000f
#define DDR_UIA_TXSLEWFALLAC 0x0000000f
#define DDR_UIA_DISABLERETRAINING 0x00000001
#define DDR_UIA_DISABLEPHYUPDATE 0x00000000
#define DDR_UIA_ENABLEHIGHCLKSKEWFIX 0x00000000
#define DDR_UIA_DISABLEUNUSEDADDRLNS 0x00000001
#define DDR_UIA_PHYINITSEQUENCENUM 0x00000000
#define DDR_UIA_ENABLEDFICSPOLARITYFIX 0x00000000
#define DDR_UIA_PHYVREF 0x0000005e
#define DDR_UIA_SEQUENCECTRL_0 0x0000031f
#define DDR_UIM_MR0_0 0x00000940
#define DDR_UIM_MR1_0 0x00000103
#define DDR_UIM_MR2_0 0x00000018
#define DDR_UIM_MR3_0 0x00000000
#define DDR_UIM_MR4_0 0x00000008
#define DDR_UIM_MR5_0 0x00000460
#define DDR_UIM_MR6_0 0x00000c16
#define DDR_UIM_MR11_0 0x00000000
#define DDR_UIM_MR12_0 0x00000000
#define DDR_UIM_MR13_0 0x00000000
#define DDR_UIM_MR14_0 0x00000000
#define DDR_UIM_MR22_0 0x00000000
					/* CPU pin -> SDRAM DDR4 Name   -> DDR Functionality */
#define DDR_UIS_SWIZZLE_0 0x00000018	/* DDR_A28 -> A[0]  (ADDR0)	-> CASN */
#define DDR_UIS_SWIZZLE_1 0x00000012	/* DDR_A22 -> A[1]  (ADDR1)	-> ACTN */
#define DDR_UIS_SWIZZLE_2 0x00000001	/* DDR_A21 -> A[2]  (ADDR2)	-> A0 */
#define DDR_UIS_SWIZZLE_3 0x00000016	/* DDR_A20 -> A[3]  (ADDR3)	-> BG0 */
#define DDR_UIS_SWIZZLE_4 0x0000000d	/* DDR_A15 -> A[4]  (ADDR4)	-> A12 */
#define DDR_UIS_SWIZZLE_5 0x00000013	/* DDR_A14 -> A[5]  (ADDR5)	-> BA0 */
#define DDR_UIS_SWIZZLE_6 0x00000019	/* DDR_A13 -> A[6]  (ADDR6)	-> RASN */
#define DDR_UIS_SWIZZLE_7 0x0000001a	/* DDR_A11 -> A[7]  (ADDR7)	-> WEN */
#define DDR_UIS_SWIZZLE_8 0x0000000e	/* DDR_A12 -> A[8]  (ADDR8)	-> A13 */
#define DDR_UIS_SWIZZLE_9 0x00000007	/* DDR_A8  -> A[9]  (ADDR9)	-> A6 */
#define DDR_UIS_SWIZZLE_10 0x00000011	/* DDR_A27 -> A[10] (ADDR10)	-> A17 (not used) */
#define DDR_UIS_SWIZZLE_11 0x00000009	/* DDR_A10 -> A[11] (ADDR11)	-> A8 */
#define DDR_UIS_SWIZZLE_12 0x0000000b	/* DDR_A9  -> A[12] (ADDR12)	-> A10 */
#define DDR_UIS_SWIZZLE_13 0x0000000c	/* DDR_A25 -> A[13] (ADDR13)	-> A11 */
#define DDR_UIS_SWIZZLE_14 0x00000000	/*         -> A[14] (ADDR14) */
#define DDR_UIS_SWIZZLE_15 0x00000000	/*         -> A[15] (ADDR15) */
#define DDR_UIS_SWIZZLE_16 0x00000000
#define DDR_UIS_SWIZZLE_17 0x00000002	/* DDR_A17 -> ACT_N (ACTN)	-> A1 */
#define DDR_UIS_SWIZZLE_18 0x00000003	/* DDR_A26 -> BA[0] (BK1)	-> A2 */
#define DDR_UIS_SWIZZLE_19 0x00000005	/* DDR_A23 -> BA[1] (BK2)	-> A4 */
#define DDR_UIS_SWIZZLE_20 0x00000000   /*         -> BA[2] (BK3) */
#define DDR_UIS_SWIZZLE_21 0x0000000a	/* DDR_A18 -> BG[0] (BG0)	-> A9 */
#define DDR_UIS_SWIZZLE_22 0x00000004	/* DDR_A16 -> BG[1] (BG1)	-> A3 */
#define DDR_UIS_SWIZZLE_23 0x00000014	/* DDR_A29 -> CAS_N (CASN)	-> BA1 */
#define DDR_UIS_SWIZZLE_24 0x00000008	/* DDR_A31 -> RAS_N (RASN)	-> A7 */
#define DDR_UIS_SWIZZLE_25 0x00000006	/* DDR_A30 -> WE_N  (WEN)	-> A5 */
#define DDR_UIS_SWIZZLE_26 0x16011218	/* 0x<DDR_UIS_SWIZZLE_3><DDR_UIS_SWIZZLE_2><DDR_UIS_SWIZZLE_1><DDR_UIS_SWIZZLE_0> */
#define DDR_UIS_SWIZZLE_27 0x1a19130d	/* 0x<DDR_UIS_SWIZZLE_7><DDR_UIS_SWIZZLE_6><DDR_UIS_SWIZZLE_5><DDR_UIS_SWIZZLE_4> */
#define DDR_UIS_SWIZZLE_28 0x0911070e	/* 0x<DDR_UIS_SWIZZLE_11><DDR_UIS_SWIZZLE_10><DDR_UIS_SWIZZLE_9><DDR_UIS_SWIZZLE_8> */
#define DDR_UIS_SWIZZLE_29 0x00000c0b	/* 0x<DDR_UIS_SWIZZLE_15><DDR_UIS_SWIZZLE_14><DDR_UIS_SWIZZLE_13><DDR_UIS_SWIZZLE_12> */
#define DDR_UIS_SWIZZLE_30 0x00050302	/* 0x<DDR_UIS_SWIZZLE_20><DDR_UIS_SWIZZLE_19><DDR_UIS_SWIZZLE_18><DDR_UIS_SWIZZLE_17> */
#define DDR_UIS_SWIZZLE_31 0x0814040a	/* 0x<DDR_UIS_SWIZZLE_24><DDR_UIS_SWIZZLE_23><DDR_UIS_SWIZZLE_22><DDR_UIS_SWIZZLE_21> */
#define DDR_UIS_SWIZZLE_32 0x00000006	/* 0x000000<DDR_UIS_SWIZZLE_25> */
#define DDR_UIS_SWIZZLE_33 0x00000000
#define DDR_UIS_SWIZZLE_34 0x00000000
#define DDR_UIS_SWIZZLE_35 0x00000000
#define DDR_UIS_SWIZZLE_36 0x00000000
#define DDR_UIS_SWIZZLE_37 0x00000000
#define DDR_UIS_SWIZZLE_38 0x00000000
#define DDR_UIS_SWIZZLE_39 0x00000000
#define DDR_UIS_SWIZZLE_40 0x00000000
#define DDR_UIS_SWIZZLE_41 0x00000000
#define DDR_UIS_SWIZZLE_42 0x00000000
#define DDR_UIS_SWIZZLE_43 0x00000000

#include "stm32mp25-ddr.dtsi"
